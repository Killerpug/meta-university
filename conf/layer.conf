## conf/layer.conf
```bitbake
# We have a conf and classes directory, add to BBPATH
BBPATH .= ":${LAYERDIR}"

# We have recipes-* directories, add to BBFILES
BBFILES += "${LAYERDIR}/recipes-*/*/*.bb \
            ${LAYERDIR}/recipes-*/*/*.bbappend"

BBFILE_COLLECTIONS += "meta-university"
BBFILE_PATTERN_meta-university = "^${LAYERDIR}/"
BBFILE_PRIORITY_meta-university = "6"

LAYERDEPENDS_meta-university = "core"
LAYERSERIES_COMPAT_meta-university = "kirkstone"
```
